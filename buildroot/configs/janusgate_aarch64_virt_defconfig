## buildroot/configs/janusgate_aarch64_virt_defconfig
```kconfig
# SPDX-License-Identifier: AGPL-3.0-or-later
# Copyright (C) 2026 Marco Fortina <marco_fortina@hotmail.it>

BR2_aarch64=y
BR2_TOOLCHAIN_BUILDROOT_MUSL=y
BR2_PACKAGE_HOST_LINUX_HEADERS_CUSTOM_6_12=y
BR2_GLOBAL_PATCH_DIR="$(BR2_EXTERNAL_JANUSGATE_PATH)/patches"
BR2_PRIMARY_SITE="https://sources.buildroot.net"
BR2_DOWNLOAD_FORCE_CHECK_HASHES=y
BR2_WGET="wget -nd -t 3 --connect-timeout=10 --read-timeout=30"
BR2_TARGET_GENERIC_HOSTNAME="janusgate"
BR2_TARGET_GENERIC_ISSUE="JanusGate firmware"
BR2_TARGET_GENERIC_GETTY_PORT="ttyAMA0"
BR2_ROOTFS_DEVICE_CREATION_DYNAMIC_DEVTMPFS=y
BR2_ROOTFS_DEVICE_TABLE_SUPPORTS_EXTENDED_ATTRIBUTES=y
# BR2_TARGET_GENERIC_REMOUNT_ROOTFS_RW is not set
BR2_ROOTFS_OVERLAY="$(BR2_EXTERNAL_JANUSGATE_PATH)/overlay"
BR2_ROOTFS_POST_BUILD_SCRIPT="$(BR2_EXTERNAL_JANUSGATE_PATH)/board/common/post-build.sh"
BR2_ROOTFS_POST_IMAGE_SCRIPT="$(BR2_EXTERNAL_JANUSGATE_PATH)/board/aarch64/post-image.sh"
BR2_ROOTFS_POST_SCRIPT_ARGS="$(BR2_EXTERNAL_JANUSGATE_PATH)"
BR2_PACKAGE_BUSYBOX_CONFIG_FRAGMENT_FILES="$(BR2_EXTERNAL_JANUSGATE_PATH)/board/common/busybox.fragment"
BR2_LINUX_KERNEL=y
BR2_LINUX_KERNEL_CUSTOM_VERSION=y
BR2_LINUX_KERNEL_CUSTOM_VERSION_VALUE="6.12.98"
BR2_LINUX_KERNEL_USE_ARCH_DEFAULT_CONFIG=y
BR2_LINUX_KERNEL_CONFIG_FRAGMENT_FILES="$(BR2_EXTERNAL_JANUSGATE_PATH)/board/common/linux.fragment"
BR2_LINUX_KERNEL_NEEDS_HOST_LIBELF=y
BR2_LINUX_KERNEL_NEEDS_HOST_OPENSSL=y
BR2_LINUX_KERNEL_IMAGE=y
BR2_PACKAGE_JANUSGATE=y
BR2_PACKAGE_ACPID=y
BR2_PACKAGE_IPROUTE2=y
BR2_TARGET_ROOTFS_SQUASHFS=y
BR2_TARGET_ROOTFS_SQUASHFS4_ZSTD=y
# BR2_TARGET_ROOTFS_TAR is not set
BR2_PACKAGE_HOST_E2FSPROGS=y
BR2_PACKAGE_HOST_GENIMAGE=y
```

## buildroot/package/janusgate/Config.in
```kconfig
# SPDX-License-Identifier: AGPL-3.0-or-later
# Copyright (C) 2026 Marco Fortina <marco_fortina@hotmail.it>

config BR2_PACKAGE_JANUSGATE
	bool "janusgate"
	depends on BR2_USE_MMU
	depends on BR2_TOOLCHAIN_HAS_THREADS
	select BR2_PACKAGE_CA_CERTIFICATES
	select BR2_PACKAGE_CIVETWEB
	select BR2_PACKAGE_CIVETWEB_LIB
	select BR2_PACKAGE_JANSSON
	select BR2_PACKAGE_LIBCAP
	select BR2_PACKAGE_LIBCURL
	select BR2_PACKAGE_LIBIDN2
	select BR2_PACKAGE_LIBMNL
	select BR2_PACKAGE_LIBNETFILTER_QUEUE
	select BR2_PACKAGE_LIBSECCOMP
	select BR2_PACKAGE_LIBSODIUM
	select BR2_PACKAGE_NFTABLES
	select BR2_PACKAGE_OPENSSL
	select BR2_PACKAGE_SQLITE
	select BR2_PACKAGE_ZLIB
	help
	  Transparent inline DNS and destination policy appliance.

comment "janusgate requires an MMU and thread support"
	depends on !BR2_USE_MMU || !BR2_TOOLCHAIN_HAS_THREADS
```
